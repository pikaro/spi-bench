## sdkconfig.defaults
```kconfig
# CONFIG_FREERTOS_HZ=1000
#
# CONFIG_ESP_MAIN_TASK_STACK_SIZE=8192
# CONFIG_ESP_SYSTEM_EVENT_TASK_STACK_SIZE=8192
# CONFIG_ESP_IPC_TASK_STACK_SIZE=2048
#
# CONFIG_SPIRAM=y
# CONFIG_SPIRAM_MODE_OCT=y
# CONFIG_SPIRAM_SPEED_80M=y
#
# CONFIG_ESP_DEFAULT_CPU_FREQ_MHZ_240=y
#
# CONFIG_ESPTOOLPY_FLASHSIZE="16MB"
#
CONFIG_FREERTOS_GENERATE_RUN_TIME_STATS=y
CONFIG_FREERTOS_USE_TRACE_FACILITY=y
CONFIG_FREERTOS_VTASKLIST_INCLUDE_COREID=y
# CONFIG_HEAP_TRACK_DELETED_TASKS=y
# CONFIG_HEAP_TRACING_STANDALONE=y
#
# # BUG: https://github.com/espressif/esp-idf/issues/17232
# CONFIG_HEAP_TASK_TRACKING=n
#
# CONFIG_LOG_DYNAMIC_LEVEL_CONTROL=y
# CONFIG_LOG_DEFAULT_LEVEL_INFO=y
# CONFIG_LOG_MAXIMUM_LEVEL_VERBOSE=y
# CONFIG_LOG_COLORS=y
```
